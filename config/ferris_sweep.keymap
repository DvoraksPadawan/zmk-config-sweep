#include <behaviors.dtsi>
#include <dt-bindings/zmk/keys.h>

/ {
    keymap {
        compatible = "zmk,keymap";

        default_layer {
            bindings = <
&kp N1  &kp N2  &kp N3  &kp N4  &kp N5  &kp N6  &kp N7  &kp N8  &kp N9  &kp N0  &kp LEFT  &kp DOWN  &kp UP  &kp RIGHT  &trans  &kp A  &kp S  &kp D  &kp F  &kp G  &kp Z  &kp Z  &trans  &trans  &trans  &kp Z  &kp X  &kp C  &kp V  &kp B  &to 1  &trans  &trans  &trans
            >;
        };

        layer_1 {
            bindings = <
&kp Q  &kp W  &kp E  &kp R  &kp T  &kp Y  &kp U  &kp I  &kp O  &kp P  &kp A  &kp S  &kp D  &kp F  &kp G  &kp H  &kp J  &kp K  &kp L  &kp SEMI  &kp SLASH  &kp Z  &kp X  &kp C  &kp V  &kp B  &kp N  &kp M  &kp COMMA  &kp DOT  &to 0  &kp SPC  &kp ENTER  &kp BACKSPACE
            >;
        };
    };
};
